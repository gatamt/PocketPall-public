## Personlig_Ai/sdkconfig.defaults
```kconfig
# ============================
# Target
# ============================
CONFIG_IDF_TARGET="esp32s3"

# Enable PNG decoder in LVGL
CONFIG_LV_USE_PNG=y
CONFIG_LV_MEM_CUSTOM=y

# ============================
# CPU
# ============================
CONFIG_ESP_DEFAULT_CPU_FREQ_MHZ_240=y

# ============================
# Flash (16MB QIO 80MHz)
# ============================
CONFIG_ESPTOOLPY_FLASHSIZE_16MB=y
CONFIG_ESPTOOLPY_FLASHFREQ_80M=y
CONFIG_ESPTOOLPY_FLASHMODE_QIO=y

# ============================
# PSRAM (8MB Octal 80MHz)
# ============================
CONFIG_SPIRAM=y
CONFIG_SPIRAM_MODE_OCT=y
CONFIG_SPIRAM_SPEED_80M=y
CONFIG_SPIRAM_MALLOC_ALWAYSINTERNAL=4096
CONFIG_SPIRAM_MALLOC_RESERVE_INTERNAL=16384

# ============================
# Partition Table
# ============================
CONFIG_PARTITION_TABLE_CUSTOM=y
CONFIG_PARTITION_TABLE_CUSTOM_FILENAME="partitions.csv"

# ============================
# FreeRTOS
# ============================
CONFIG_FREERTOS_HZ=1000

# ============================
# System event task — larger stack for WiFi scan callbacks
# ============================
CONFIG_ESP_SYSTEM_EVENT_TASK_STACK_SIZE=4096

# ============================
# WiFi — all comms via TCP over iPhone Personal Hotspot
# ============================
CONFIG_ESP_WIFI_ENABLED=y
CONFIG_ESP_WIFI_STATIC_RX_BUFFER_NUM=10
CONFIG_ESP_WIFI_DYNAMIC_RX_BUFFER_NUM=32
CONFIG_ESP_WIFI_TX_BUFFER_TYPE=1
CONFIG_ESP_WIFI_DYNAMIC_TX_BUFFER_NUM=32
CONFIG_ESP_WIFI_AMPDU_TX_ENABLED=y
CONFIG_ESP_WIFI_AMPDU_RX_ENABLED=y
CONFIG_PM_ENABLE=n

# ============================
# Bluetooth disabled (shares antenna with WiFi)
# ============================
CONFIG_BT_ENABLED=n

# ============================
# LWIP / TCP tuning for real-time audio
# ============================
CONFIG_LWIP_TCP_MSS=1460
CONFIG_LWIP_TCP_SND_BUF_DEFAULT=5744
CONFIG_LWIP_TCP_WND_DEFAULT=5744
CONFIG_LWIP_TCP_RECVMBOX_SIZE=12
CONFIG_LWIP_TCPIP_RECVMBOX_SIZE=16

# ============================
# Logging
# ============================
CONFIG_LOG_DEFAULT_LEVEL_INFO=y

# ============================
# LVGL
# ============================
CONFIG_LV_COLOR_16_SWAP=y
CONFIG_LV_FONT_MONTSERRAT_18=y
CONFIG_LV_FONT_MONTSERRAT_24=y

# ============================
# Compiler
# ============================
CONFIG_COMPILER_OPTIMIZATION_PERF=y

# ============================
# Task Watchdog
# ============================
CONFIG_ESP_TASK_WDT_TIMEOUT_S=30
```
